## config/west.yml
```yaml
manifest:
  remotes:
    - name: zmkfirmware
      url-base: https://github.com/zmkfirmware
      # Additional modules containing boards/shields/custom code can be listed here as well.
      # See:
      # - https://zmk.dev/docs/features/modules
      # - https://docs.zephyrproject.org/3.5.0/develop/west/manifest.html#projects
    - name: carrefinho                            # Prospector dongle
      url-base: https://github.com/carrefinho     # Prospector dongle
    - name: janpfischer                           # zmk-dongle-screen
      url-base: https://github.com/janpfischer    # zmk-dongle-screen
  projects:
    - name: eyelash_sofle
      url: https://github.com/wxsh/zmk-sofle
      revision: Dongle
    - name: zmk
      remote: zmkfirmware
      revision: v0.3.0
      import: app/west.yml
    - name: prospector-zmk-module                 # Prospector dongle
      remote: carrefinho                          # Prospector dongle
      revision: main                              # Prospector dongle
    - name: zmk-dongle-screen                     # zmk-dongle-screen
      remote: janpfischer                         # zmk-dongle-screen
      revision: 0.1.0
  self:
    path: config
```
